## boards/holyiot/holyiot_21011/Kconfig.holyiot_21011
```kconfig
# Holyiot 21011 board configuration
# SPDX-License-Identifier: Apache-2.0

config BOARD_HOLYIOT_21011
	select SOC_NRF52810_QFAA
```

## boards/holyiot/holyiot_21011/board.yml
```yaml
board:
  name: holyiot_21011
  full_name: Holyiot 21011 (nRF52810 + LIS2DH12)
  vendor: holyiot
  socs:
  - name: nrf52810
```
